/**
 * @cliArgs --board "/ti/boards/MSP_EXP432P401R" --product "simplelink_msp432p4_sdk@3.40.01.02"
 * @versions {"data":"2021010520","timestamp":"2021010520","tool":"1.7.0+1746","templates":null}
 */

/**
 * Import the modules used in this configuration.
 */
const Display  = scripting.addModule("/ti/display/Display", {}, false);
const Display1 = Display.addInstance();
const ADC      = scripting.addModule("/ti/drivers/ADC", {}, false);
const ADC1     = ADC.addInstance();
const ADC2     = ADC.addInstance();
const GPIO     = scripting.addModule("/ti/drivers/GPIO", {}, false);
const GPIO1    = GPIO.addInstance();
const GPIO2    = GPIO.addInstance();
const GPIO3    = GPIO.addInstance();
const GPIO4    = GPIO.addInstance();
const GPIO5    = GPIO.addInstance();
const GPIO6    = GPIO.addInstance();
const GPIO7    = GPIO.addInstance();
const GPIO8    = GPIO.addInstance();
const GPIO9    = GPIO.addInstance();
const GPIO10   = GPIO.addInstance();
const GPIO11   = GPIO.addInstance();
const GPIO12   = GPIO.addInstance();
const GPIO13   = GPIO.addInstance();
const GPIO14   = GPIO.addInstance();
const GPIO15   = GPIO.addInstance();
const GPIO16   = GPIO.addInstance();
const GPIO17   = GPIO.addInstance();
const GPIO18   = GPIO.addInstance();
const GPIO19   = GPIO.addInstance();
const GPIO20   = GPIO.addInstance();
const GPIO21   = GPIO.addInstance();
const GPIO22   = GPIO.addInstance();
const GPIO23   = GPIO.addInstance();
const GPIO24   = GPIO.addInstance();
const I2C      = scripting.addModule("/ti/drivers/I2C", {}, false);
const I2C1     = I2C.addInstance();
const I2C2     = I2C.addInstance();
const PWM      = scripting.addModule("/ti/drivers/PWM");
const PWM1     = PWM.addInstance();
const PWM2     = PWM.addInstance();
const PWM3     = PWM.addInstance();
const PWM4     = PWM.addInstance();
const PWM5     = PWM.addInstance();
const PWM6     = PWM.addInstance();
const PWM7     = PWM.addInstance();
const PWM8     = PWM.addInstance();
const PWM9     = PWM.addInstance();
const PWM10    = PWM.addInstance();
const RTOS     = scripting.addModule("/ti/drivers/RTOS");
const SPI      = scripting.addModule("/ti/drivers/SPI", {}, false);
const SPI1     = SPI.addInstance();
const SPI2     = SPI.addInstance();
const Timer    = scripting.addModule("/ti/drivers/Timer", {}, false);
const Timer1   = Timer.addInstance();
const Timer2   = Timer.addInstance();
const UART     = scripting.addModule("/ti/drivers/UART", {}, false);
const UART1    = UART.addInstance();
const UART2    = UART.addInstance();
const UART3    = UART.addInstance();
const Button   = scripting.addModule("/ti/drivers/apps/Button", {}, false);
const Button1  = Button.addInstance();
const Button2  = Button.addInstance();
const LED      = scripting.addModule("/ti/drivers/apps/LED", {}, false);
const LED1     = LED.addInstance();
const LED2     = LED.addInstance();

/**
 * Write custom configuration values to the imported modules.
 */
Display1.$name      = "CONFIG_Display_0";
Display1.$hardware  = system.deviceData.board.components.XDS110UART;
Display1.uart.$name = "CONFIG_UART_0";

ADC1.$name              = "CONFIG_TSL1401_ADC";
ADC1.resolution         = "8 Bits";
ADC1.adc.adcPin.$assign = "boosterpack.29";

ADC2.$name = "Power_ADC";

GPIO1.$name              = "CONFIG_TFT_RES";
GPIO1.mode               = "Output";
GPIO1.initialOutputState = "High";
GPIO1.gpioPin.$assign    = "boosterpack.12";

GPIO2.$name           = "CONFIG_TFT_DC";
GPIO2.mode            = "Output";
GPIO2.gpioPin.$assign = "boosterpack.13";

GPIO3.$name           = "CONFIG_EC11_A";
GPIO3.pull            = "Pull Up";
GPIO3.gpioPin.$assign = "boosterpack.33";

GPIO4.$name           = "CONFIG_EC11_B";
GPIO4.pull            = "Pull Up";
GPIO4.gpioPin.$assign = "boosterpack.32";

GPIO5.$name           = "CONFIG_EC11_BUTTON";
GPIO5.pull            = "Pull Up";
GPIO5.gpioPin.$assign = "boosterpack.31";

GPIO6.$name           = "TSL1401_SI_GPIO";
GPIO6.mode            = "Output";
GPIO6.gpioPin.$assign = "boosterpack.27";

GPIO7.$name           = "TSL1401_CLK_GPIO";
GPIO7.mode            = "Output";
GPIO7.gpioPin.$assign = "boosterpack.28";

GPIO8.$name           = "ENCODER_1A";
GPIO8.gpioPin.$assign = "boosterpack.2";

GPIO9.$name           = "ENCODER_1B";
GPIO9.gpioPin.$assign = "boosterpack.23";

GPIO10.$name           = "ENCODER_2A";
GPIO10.gpioPin.$assign = "boosterpack.36";

GPIO11.$name           = "ENCODER_2B";
GPIO11.gpioPin.$assign = "boosterpack.35";

GPIO12.$name           = "ENCODER_3A";
GPIO12.gpioPin.$assign = "boosterpack.24";

GPIO13.$name           = "ENCODER_3B";
GPIO13.gpioPin.$assign = "boosterpack.5";

GPIO14.$name           = "ENCODER_4A";
GPIO14.gpioPin.$assign = "boosterpack.25";

GPIO15.$name           = "ENCODER_4B";
GPIO15.gpioPin.$assign = "boosterpack.6";

GPIO16.$name           = "AIN1";
GPIO16.mode            = "Output";
GPIO16.gpioPin.$assign = "expansion.1";

GPIO17.$name              = "AIN2";
GPIO17.mode               = "Output";
GPIO17.initialOutputState = "High";
GPIO17.gpioPin.$assign    = "expansion.3";

GPIO18.$name           = "BIN1";
GPIO18.mode            = "Output";
GPIO18.gpioPin.$assign = "expansion.5";

GPIO19.$name              = "BIN2";
GPIO19.mode               = "Output";
GPIO19.initialOutputState = "High";
GPIO19.gpioPin.$assign    = "expansion.2";

GPIO20.$name           = "CIN1";
GPIO20.mode            = "Output";
GPIO20.gpioPin.$assign = "expansion.4";

GPIO21.$name              = "CIN2";
GPIO21.mode               = "Output";
GPIO21.initialOutputState = "High";
GPIO21.gpioPin.$assign    = "expansion.6";

GPIO22.$name           = "DIN1";
GPIO22.mode            = "Output";
GPIO22.gpioPin.$assign = "expansion.8";

GPIO23.$name              = "DIN2";
GPIO23.mode               = "Output";
GPIO23.initialOutputState = "High";
GPIO23.gpioPin.$assign    = "expansion.10";

GPIO24.$name           = "CONFIG_TFT_CS";
GPIO24.mode            = "Output";
GPIO24.gpioPin.$assign = "boosterpack.11";

I2C1.$name              = "CONFIG_I2C_0";
I2C1.i2c.sdaPin.$assign = "boosterpack.10";
I2C1.i2c.sclPin.$assign = "boosterpack.9";

I2C2.$name = "CONFIG_I2C_1";

PWM1.$name     = "CONFIG_PWM_0";
PWM1.$hardware = system.deviceData.board.components.LED2_RED;

PWM2.$name     = "CONFIG_PWM_1";
PWM2.$hardware = system.deviceData.board.components.LED2_GREEN;

PWM3.$name                = "CONFIG_PWM_2";
PWM3.timer.pwmPin.$assign = "boosterpack.34";

PWM4.$name                = "CONFIG_PWM_3";
PWM4.timer.pwmPin.$assign = "boosterpack.38";

PWM5.$name                = "CONFIG_PWM_4";
PWM5.timer.pwmPin.$assign = "boosterpack.37";

PWM6.$name                = "CONFIG_PWM_5";
PWM6.timer.pwmPin.$assign = "boosterpack.17";

PWM7.$name                = "CONFIG_PWM_6";
PWM7.timer.pwmPin.$assign = "expansion.32";

PWM8.$name                = "CONFIG_PWM_7";
PWM8.timer.pwmPin.$assign = "expansion.9";

PWM9.$name                = "CONFIG_PWM_8";
PWM9.timer.pwmPin.$assign = "expansion.12";

PWM10.$name                = "CONFIG_PWM_10";
PWM10.timer.pwmPin.$assign = "expansion.7";

const Power                   = scripting.addModule("/ti/drivers/Power", {}, false);
Power.performanceLevel3.$name = "ti_drivers_power_PowerMSP432PerfLevels0";
Power.performanceLevel2.$name = "ti_drivers_power_PowerMSP432PerfLevels1";
Power.performanceLevel1.$name = "ti_drivers_power_PowerMSP432PerfLevels2";
Power.performanceLevel0.$name = "ti_drivers_power_PowerMSP432PerfLevels3";


SPI1.$name                = "CONFIG_SPI_0";
SPI1.defaultTxBufferValue = "0xFF";
SPI1.spi.$assign          = "EUSCI_B0";
SPI1.spi.sclkPin.$assign  = "boosterpack.7";
SPI1.spi.misoPin.$assign  = "boosterpack.14";
SPI1.spi.mosiPin.$assign  = "boosterpack.15";

SPI2.$name               = "CONFIG_SPI_1";
SPI2.spi.sclkPin.$assign = "expansion.25";
SPI2.spi.misoPin.$assign = "expansion.18";
SPI2.spi.mosiPin.$assign = "expansion.26";

Timer1.$name     = "CONFIG_TIMER_0";
Timer1.timerType = "32 Bits";

Timer2.$name     = "CONFIG_TIMER_1";
Timer2.timerType = "32 Bits";

UART1.$name              = "CONFIG_UART_1";
UART1.baudRates          = [9600];
UART1.uart.txPin.$assign = "boosterpack.39";
UART1.uart.rxPin.$assign = "boosterpack.19";

UART2.$name              = "CONFIG_UART_2";
UART2.uart.txPin.$assign = "boosterpack.18";
UART2.uart.rxPin.$assign = "boosterpack.40";

UART3.$name = "CONFIG_UART_3";

Button1.$name         = "CONFIG_BUTTON_0";
Button1.$hardware     = system.deviceData.board.components.S1;
Button1.gpioPin.$name = "CONFIG_GPIO_0";

Button2.$name         = "CONFIG_BUTTON_1";
Button2.$hardware     = system.deviceData.board.components.S2;
Button2.gpioPin.$name = "CONFIG_GPIO_1";

LED1.$name     = "CONFIG_LED_0";
LED1.$hardware = system.deviceData.board.components.LED1_RED;

LED2.$name     = "CONFIG_LED_1";
LED2.$hardware = system.deviceData.board.components.LED2_BLUE;

/**
 * Pinmux solution for unlocked pins/peripherals. This ensures that minor changes to the automatic solver in a future
 * version of the tool will not impact the pinmux you originally saw.  These lines can be completely deleted in order to
 * re-solve from scratch.
 */
Display1.uart.uart.$suggestSolution          = "EUSCI_A0";
Display1.uart.uart.txPin.$suggestSolution    = "7";
Display1.uart.uart.rxPin.$suggestSolution    = "6";
ADC1.adc.$suggestSolution                    = "ADC14";
ADC2.adc.$suggestSolution                    = "ADC14";
ADC2.adc.adcPin.$suggestSolution             = "boosterpack.30";
I2C1.i2c.$suggestSolution                    = "EUSCI_B1";
I2C2.i2c.$suggestSolution                    = "EUSCI_B3";
I2C2.i2c.sdaPin.$suggestSolution             = "expansion.29";
I2C2.i2c.sclPin.$suggestSolution             = "expansion.30";
PWM1.timer.$suggestSolution                  = "Timer_A1";
PWM1.timer.pwmPin.$suggestSolution           = "16";
PWM2.timer.$suggestSolution                  = "Timer_A1";
PWM2.timer.pwmPin.$suggestSolution           = "17";
PWM3.timer.$suggestSolution                  = "Timer_A1";
PWM4.timer.$suggestSolution                  = "Timer_A1";
PWM5.timer.$suggestSolution                  = "Timer_A2";
PWM6.timer.$suggestSolution                  = "Timer_A2";
PWM7.timer.$suggestSolution                  = "Timer_A3";
PWM8.timer.$suggestSolution                  = "Timer_A3";
PWM9.timer.$suggestSolution                  = "Timer_A3";
PWM10.timer.$suggestSolution                 = "Timer_A3";
RTOS.timer0.resource.$suggestSolution        = "Timer_A0";
SPI1.spi.dmaRxChannel.$suggestSolution       = "DMA_CH3";
SPI1.spi.dmaTxChannel.$suggestSolution       = "DMA_CH2";
SPI1.spi.dmaInterruptNumber.$suggestSolution = "DMA_INT1";
SPI2.spi.$suggestSolution                    = "EUSCI_B2";
SPI2.spi.dmaRxChannel.$suggestSolution       = "DMA_CH1";
SPI2.spi.dmaTxChannel.$suggestSolution       = "DMA_CH0";
SPI2.spi.dmaInterruptNumber.$suggestSolution = "DMA_INT0";
Timer1.timer.$suggestSolution                = "TIMER32_1";
Timer2.timer.$suggestSolution                = "TIMER32_0";
UART1.uart.$suggestSolution                  = "EUSCI_A2";
UART2.uart.$suggestSolution                  = "EUSCI_A1";
UART3.uart.$suggestSolution                  = "EUSCI_A3";
UART3.uart.txPin.$suggestSolution            = "expansion.22";
UART3.uart.rxPin.$suggestSolution            = "expansion.19";
Button1.gpioPin.gpioPin.$suggestSolution     = "5";
Button2.gpioPin.gpioPin.$suggestSolution     = "8";
LED1.gpioPin.gpioPin.$suggestSolution        = "4";
LED2.gpioPin.gpioPin.$suggestSolution        = "18";
